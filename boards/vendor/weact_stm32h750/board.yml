## boards/vendor/weact_stm32h750/board.yml
```yaml
board:
  name: weact_stm32h750
  full_name: WeAct Studio weact_stm32h750 Core Board
  vendor: weact
  socs:
    - name: stm32h750xx
```

## boards/vendor/weact_stm32h750/weact_stm32h750_defconfig
```kconfig
# SPDX-License-Identifier: Apache-2.0

# Enable MPU
CONFIG_ARM_MPU=y

# Enable HW stack protection
CONFIG_HW_STACK_PROTECTION=y

# Enable UART
CONFIG_SERIAL=y

# Console
CONFIG_CONSOLE=y
CONFIG_UART_CONSOLE=y

# Enable GPIO
CONFIG_GPIO=y


# If linker still places ROM at 0x08000000,
# uncomment the two lines below to force ROM to external mapped base (STM32H7 QSPI @ 0x90000000)
# CONFIG_FLASH_BASE_ADDRESS=0x90000000
# # in KB (8MB device / adjust to your code partition size)
# CONFIG_FLASH_SIZE=8192  
```

## mcuboot/boards/weact_stm32h750.conf
```kconfig
# bootloader/boards/weact_stm32h750_mini.conf
# Board-specific MCUboot configuration
# Author: MyFlyChicken

# 使用 QSPI Flash
CONFIG_FLASH=y
CONFIG_SPI=y
CONFIG_SPI_NOR=y

# 使用 UART3 作为控制台
CONFIG_UART_CONSOLE=y
CONFIG_PRINTK=y

# 禁用不需要的外设
CONFIG_I2C=n
CONFIG_USB_DEVICE_STACK=n
```
