## CMakeLists.txt
```
# SPDX-License-Identifier: Apache-2.0

cmake_minimum_required(VERSION 3.20.0)
# set(FLASH_LOAD_OFFSET 0x90000000)
set(BOARD_ROOT "${CMAKE_CURRENT_LIST_DIR}/..")
find_package(Zephyr REQUIRED HINTS $ENV{ZEPHYR_BASE})
project(prj-learn)

# src/led.c src/button.c
target_sources(app PRIVATE src/led.c)
```

## prj.conf
```kconfig
CONFIG_I2C=y
# CONFIG_INIT_STACKS is not set
CONFIG_HW_STACK_PROTECTION=y
CONFIG_GPIO=y
CONFIG_CONSOLE=y
CONFIG_MCUBOOT_GENERATE_CONFIRMED_IMAGE=y
CONFIG_BOOTLOADER_MCUBOOT=y
CONFIG_MCUBOOT_SIGNATURE_KEY_FILE="bootloader/mcuboot/root-rsa-2048.pem"
CONFIG_MCUBOOT_IMGTOOL_SIGN_VERSION="0.0.1"
CONFIG_ARM_MPU=y
# CONFIG_INIT_ARCH_HW_AT_BOOT is not set
# CONFIG_THREAD_MONITOR is not set
# CONFIG_THREAD_NAME is not set
# CONFIG_DEVICE_DT_METADATA is not set
CONFIG_UART_CONSOLE=y
CONFIG_DISPLAY=n
CONFIG_GPIO_SHELL=y
CONFIG_I2C_SHELL=n
CONFIG_SPI_SHELL=y
CONFIG_SHELL=y


# ------------------------------------------------------------------
# MCUboot / placement settings
# Ensure the application image is built to the same flash location
# that MCUboot expects. On this board the external QSPI NOR is
# mapped as an XIP device (typically at 0x90000000) and the
# image partition 'image-0' in the board DTS starts at offset 0x0
# within that device. To let MCUboot jump to the app in external
# flash (direct-XIP), set the load offset to the QSPI mapping.
# Replace the offset below if your QSPI is mapped elsewhere.
# ------------------------------------------------------------------
CONFIG_USE_DT_CODE_PARTITION=y
CONFIG_XIP=y
# If your external QSPI is memory-mapped at 0x90000000, set the
# FLASH_LOAD_OFFSET so the generated binary lines up with that
# address when flashing. Change to match your board's DT if needed.
# CONFIG_FLASH_LOAD_OFFSET=0x90000000

# MCUboot signing (ensure the referenced key exists or generate one)
CONFIG_MCUBOOT_GENERATE_CONFIRMED_IMAGE=y
CONFIG_MCUBOOT_SIGNATURE_KEY_FILE="bootloader/mcuboot/root-rsa-2048.pem"
```

## boards/weact_stm32h750.conf
```kconfig
# This option enables the MemoryMapped mode for the external NOR flash mounted on STM32 boards
CONFIG_STM32_MEMMAP=y
```

## boards/weact_stm32h750.overlay
```dts
/* MCUBoot overlay for WeAct STM32H750 board
 * - Place MCUBoot in internal flash (128KB)
 * - Define external QSPI slots for Direct-XIP
 */

/ {
	/* For MCUBoot itself, link to internal flash */
	chosen {
		// !!!zephyr,code-partition指向的分区必须为zephyr,flash下边的.
		// !!!构建系统总会认为code-partition指向的是zephyr,flash下边的分区，如果两者不匹配会出现意外错误
		zephyr,flash = &w25q64_qspi;
		zephyr,code-partition = &slot0_partition;
	};
};
```

## src/led.c
```c
/*
 * Copyright (c) 2017 Linaro Limited
 *
 * SPDX-License-Identifier: Apache-2.0
 */

#include <zephyr/kernel.h>
#include <zephyr/device.h>
#include <zephyr/drivers/gpio.h>
#include <zephyr/sys/printk.h>
#include <zephyr/sys/__assert.h>
#include <string.h>

#define LED0_NODE DT_ALIAS(led0)

#if !DT_NODE_HAS_STATUS(LED0_NODE, okay)
#error "Unsupported board: led0 devicetree alias is not defined"
#endif

// 定义led结构体
struct led {
	struct gpio_dt_spec spec;
	uint8_t num;
};

static const struct led leds[] = {
    {
        .spec = GPIO_DT_SPEC_GET_OR(LED0_NODE, gpios, {0}),
        .num = 0,
    },
};

/**
 * @brief Blink the LED
 * @param [in] led Pointer to the LED structure
 * @param [in] sleep_ms Sleep duration in milliseconds
 *
 * @details This function configures the LED GPIO pin and starts blinking it
 *          with the specified sleep duration.
 */
void blink(const struct led *led, uint32_t sleep_ms)
{
	const struct gpio_dt_spec *spec = &led->spec;
	int cnt = 0;
	int ret;

	if (!device_is_ready(spec->port)) {
		printk("Error: %s device is not ready\n", spec->port->name);
		return;
	}

	ret = gpio_pin_configure_dt(spec, GPIO_OUTPUT);
	if (ret != 0) {
		printk("Error %d: failed to configure pin %d (LED '%d')\n",
			ret, spec->pin, led->num);
		return;
	}

	while (1) {
		gpio_pin_set(spec->port, spec->pin, cnt % 2);
        printk("LED '%d' blink %d\n", led->num, cnt);
		k_msleep(sleep_ms);
		cnt++;
	}
}

void blink_task0(void)
{
    blink(&leds[0], 1000);
}

K_THREAD_DEFINE(blink_task0_id, 512, blink_task0, NULL, NULL, NULL,
                7, 0, 0);
```
